## drivers/block/nand_sun7i/Kconfig
```kconfig
config SUN7I_NAND
	depends on BLOCK
	depends on ARCH_SUN7I
	select SUNXI_NAND_PARTITION
	tristate "SUN7I v2.xx Nandflash Driver"
	---help---
	  Build AllWinner SUNXI sun7i NAND driver version v2.xx
	  from Allwinner SDK2.0 Lichee-3.4
```

## drivers/gpu/mali_r3p2-01rel2/Kconfig
```kconfig
config MALI
	tristate "ARM Mali GPU modules"
	depends on ARM && m
        select UMP
        select MALI400
	default n
	help
	  This enables the generation of mali.ko and ump.ko, and allows FB/UMP integration (see framebuffer).

source "drivers/gpu/mali_r3p2-01rel2/mali/Kconfig"
source "drivers/gpu/mali_r3p2-01rel2/ump/Kconfig"
```
